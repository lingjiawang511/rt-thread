## components/platform/0001_key/Kconfig
```kconfig
menu "Meter 0001_key component"

config RT_USING_COMPONENTS_METER_KEY
	bool "Use meter key components"
	default y
	
endmenu
```

## components/platform/0002_display/Kconfig
```kconfig
menu "Meter 0002_display"

config RT_USING_COMPONENTS_METER_DISPLAY
  bool "Use meter display components"
  default y
choice
    prompt "Use witch gui display"
    default MY_GUI_DISPLAY
    config MY_GUI_DISPLAY
        bool "my_gui display"
    config EMWIN_DISPLAY
        bool "emwin_display"
endchoice

if RT_USING_COMPONENTS_METER_DISPLAY
  	if MY_GUI_DISPLAY
		source "$RTT_DIR/components/platform/0002_display/mygui/Kconfig"
	endif
	if EMWIN_DISPLAY
		source "$RTT_DIR/components/platform/0002_display/STemWinLibrary532/Kconfig"
		source "$RTT_DIR/components/platform/0002_display/font/Kconfig"
	endif
endif
endmenu
```

## components/platform/0002_display/STemWinLibrary532/Kconfig
```kconfig
config RT_USING_COMPONENTS_METER_DISPLAY_EMWINGUI
	bool "Use emwin gui library"
	default y
```

## components/platform/0002_display/font/Kconfig
```kconfig
if EMWIN_DISPLAY
    config RT_USING_COMPONENTS_METER_DISPLAY_FONT
        bool "Use font for to support show text"
        default y
endif
if RT_USING_COMPONENTS_METER_DISPLAY_FONT
    config RT_USING_COMPONENTS_METER_DISPLAY_FONT_12
        bool "Use 12 font"
        default y
    config RT_USING_COMPONENTS_METER_DISPLAY_FONT_16
        bool "Use 16 font"
        default y
    config RT_USING_COMPONENTS_METER_DISPLAY_FONT_24
        bool "Use 24 font"
        default y
    config RT_USING_COMPONENTS_METER_DISPLAY_FONT_32
        bool "Use 32 font"
        default y
    config RT_USING_COMPONENTS_METER_DISPLAY_FONT_48
        bool "Use 48 font"
        default y
    config RT_USING_COMPONENTS_METER_DISPLAY_FONT_64
        bool "Use 64 font"
        default y
    config RT_USING_COMPONENTS_METER_DISPLAY_FONT_80
        bool "Use 80 font"
        default y
endif
```

## components/platform/0002_display/mygui/Kconfig
```kconfig
if MY_GUI_DISPLAY
	config RT_USING_COMPONENTS_METER_MYGUI
		bool "Use mygui display meter"
		default n
endif
```

## components/platform/0003_digitalinput/Kconfig
```kconfig
menu "Meter 0003_digital input"

config RT_USING_COMPONENTS_METER_DIN
	bool "Use digital input components"
	default y

if RT_USING_COMPONENTS_METER_DIN
config RT_USING_COMPONENTS_METER_DIN_SRT20X68
	bool "Use srt20x68 digital input sensor"
	default y
config RT_USING_COMPONENTS_METER_DIN_HC4
	bool "Use HC4 digital input sensor"
	default n
endif
	
endmenu
```

## components/platform/0004_anologinput/Kconfig
```kconfig
menu "Meter 0004_anolog input"

config RT_USING_COMPONENTS_METER_AIN
	bool "Use anolog input components"
	default y
	
if RT_USING_COMPONENTS_METER_AIN
config RT_USING_ADC
	bool "Use on chip adc for anolog input"
	default y
config RT_USING_COMPONENTS_METER_ADIN_EXTERNAL
	bool "Use external adc for anolog input"
	default n
endif

endmenu
```

## components/platform/0005_dew_processing/Kconfig
```kconfig
menu "Meter 0005_dew_processing"

config RT_USING_COMPONENTS_METER_DEW_PROCESSING
	bool "Use meter dew processing components"
	default y
	
endmenu
```

## components/platform/0006_loadcell_processing/Kconfig
```kconfig
menu "Meter 0006_loadcell_processing"

config RT_USING_COMPONENTS_METER_LOADCELL_PROCESSING
	bool "Use loadcell processing components"
	default y
	
endmenu
```

## components/platform/0007_digital_output/Kconfig
```kconfig
menu "Meter 0007_digital_output component"

config RT_USING_COMPONENTS_METER_DOUT
	bool "Use digital out components"
	default y

endmenu
```

## components/platform/0008_analog_output/Kconfig
```kconfig
menu "Meter 0008_anolog output"

config RT_USING_COMPONENTS_METER_AOUT
	bool "Use anolog output components"
	default y
	
endmenu
```

## components/platform/0009_charger/Kconfig
```kconfig
menu "Meter 0009_charging"

config RT_USING_COMPONENTS_METER_CHARGING
	bool "Use charging components"
	default y
	
endmenu
```

## components/platform/0010_data_logging/Kconfig
```kconfig
menu "Meter 0010_data_logging"

config RT_USING_COMPONENTS_METER_LOGGING
	bool "Use data logging components"
	default y
	
endmenu
```

## components/platform/0011_eeprom/Kconfig
```kconfig
menu "Meter 0011_eeprom"

config RT_USING_COMPONENTS_METER_EEPROM
	bool "Use eeprom components"
	default y
	
endmenu
```

## components/platform/Kconfig
```kconfig
menu "Meter core"

config RT_USING_COMPONENTS_METER_CORE
    bool "Use METER_CORE components"
    default y
	if RT_USING_COMPONENTS_METER_CORE
		source "$RTT_DIR/components/platform/0001_key/Kconfig"
		source "$RTT_DIR/components/platform/0002_display/Kconfig"
		source "$RTT_DIR/components/platform/0003_digitalinput/Kconfig"
		source "$RTT_DIR/components/platform/0004_anologinput/Kconfig"
		source "$RTT_DIR/components/platform/0005_dew_processing/Kconfig"
		source "$RTT_DIR/components/platform/0006_loadcell_processing/Kconfig"
		source "$RTT_DIR/components/platform/0007_digital_output/Kconfig"
		source "$RTT_DIR/components/platform/0008_analog_output/Kconfig"
		source "$RTT_DIR/components/platform/0009_charger/Kconfig"
		source "$RTT_DIR/components/platform/0010_data_logging/Kconfig"
		source "$RTT_DIR/components/platform/0011_eeprom/Kconfig"
	endif
endmenu
```
