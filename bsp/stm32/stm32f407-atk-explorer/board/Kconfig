## bsp/stm32/stm32f407-atk-explorer/board/Kconfig
```kconfig
menu "Hardware Drivers Config"

config SOC_SERIES_STM32F4
    bool
    select RT_USING_COMPONENTS_INIT
    select RT_USING_USER_MAIN
    default y
choice
    prompt "Device type"
    default SOC_STM32F401RC
    config SOC_STM32F405RG
        bool "STM32F405RG"
    config SOC_STM32F405VG
        bool "STM32F405VG"
    config SOC_STM32F405ZG
        bool "STM32F405ZG"
    config SOC_STM32F415RG
        bool "STM32F415RG"
    config SOC_STM32F415VG
        bool "STM32F415VG"
    config SOC_STM32F415ZG
        bool "STM32F415ZG"
    config SOC_STM32F407VG
        bool "STM32F407VG"
    config SOC_STM32F407VE
        bool "STM32F407VE"
    config SOC_STM32F407ZG
        bool "STM32F407ZG"
    config SOC_STM32F407ZE
        bool "STM32F407ZE"
    config SOC_STM32F407IG
        bool "STM32F407IG"
    config SOC_STM32F407IE
        bool "STM32F407IE"
    config SOC_STM32F417VG
        bool "STM32F417VG"
    config SOC_STM32F417VE
        bool "STM32F417VE"
    config SOC_STM32F417ZG
        bool "STM32F417ZG"
    config SOC_STM32F417ZE
        bool "STM32F417ZE"
    config SOC_STM32F417IG
        bool "STM32F417IG"
    config SOC_STM32F417IE
        bool "STM32F417IE"
    config SOC_STM32F427VG
        bool "STM32F427VG"
    config SOC_STM32F427VI
        bool "STM32F427VI"
    config SOC_STM32F427ZG
        bool "STM32F427ZG"
    config SOC_STM32F427ZI
        bool "STM32F427ZI"
    config SOC_STM32F427IG
        bool "STM32F427IG"
    config SOC_STM32F427II
        bool "STM32F427II"
    config SOC_STM32F437VG
        bool "STM32F437VG"
    config SOC_STM32F437VI
        bool "STM32F437VI"
    config SOC_STM32F437ZG
        bool "STM32F437ZG"
    config SOC_STM32F437ZI
        bool "STM32F437ZI"
    config SOC_STM32F437IG
        bool "STM32F437IG"
    config SOC_STM32F437II
        bool "STM32F437II"
    config SOC_STM32F429VG
        bool "STM32F429VG"
    config SOC_STM32F429VI
        bool "STM32F429VI"
    config SOC_STM32F429ZG
        bool "STM32F429ZG"
    config SOC_STM32F429ZI
        bool "STM32F429ZI"
    config SOC_STM32F429BG
        bool "STM32F429BG"
    config SOC_STM32F429BI
        bool "STM32F429BI"
    config SOC_STM32F429NG
        bool "STM32F429NG"
    config SOC_STM32F429NI
        bool "STM32F429NI"
    config SOC_STM32F429IG
        bool "STM32F429IG"
    config SOC_STM32F429II
        bool "STM32F429II"
    config SOC_STM32F439VG
        bool "STM32F439VG"
    config SOC_STM32F439VI
        bool "STM32F439VI"
    config SOC_STM32F439ZG
        bool "STM32F439ZG"
    config SOC_STM32F439ZI
        bool "STM32F439ZI"
    config SOC_STM32F439BG
        bool "STM32F439BG"
    config SOC_STM32F439BI
        bool "STM32F439BI"
    config SOC_STM32F439NG
        bool "STM32F439NG"
    config SOC_STM32F439NI
        bool "STM32F439NI"
    config SOC_STM32F439IG
        bool "STM32F439IG"
    config SOC_STM32F439II
        bool "STM32F439II"
    config SOC_STM32F401CB
        bool "STM32F401CB"
    config SOC_STM32F401CC
        bool "STM32F401CC"
    config SOC_STM32F401RB
        bool "STM32F401RB"
    config SOC_STM32F401RC
        bool "STM32F401RC"
    config SOC_STM32F401VB
        bool "STM32F401VB"
    config SOC_STM32F401VC
        bool "STM32F401VC"
    config SOC_STM32F401CD
        bool "STM32F401CD"
    config SOC_STM32F401RD
        bool "STM32F401RD"
    config SOC_STM32F401VD
        bool "STM32F401VD"
    config SOC_STM32F401CE
        bool "STM32F401CE"
    config SOC_STM32F401RE
        bool "STM32F401RE"
    config SOC_STM32F401VE
        bool "STM32F401VE"
    config SOC_STM32F410T8
        bool "STM32F410T8"
    config SOC_STM32F410TB
        bool "STM32F410TB"
    config SOC_STM32F410C8
        bool "STM32F410C8"
    config SOC_STM32F410CB
        bool "STM32F410CB"
    config SOC_STM32F410R8
        bool "STM32F410R8"
    config SOC_STM32F410RB
        bool "STM32F410RB"
    config SOC_STM32F411CC
        bool "STM32F411CC"
    config SOC_STM32F411RC
        bool "STM32F411RC"
    config SOC_STM32F411VC
        bool "STM32F411VC"
    config SOC_STM32F411CE
        bool "STM32F411CE"
    config SOC_STM32F411RE
        bool "STM32F411RE"
    config SOC_STM32F411VE
        bool "STM32F411VE"
    config SOC_STM32F446MC
        bool "STM32F446MC"
    config SOC_STM32F446ME
        bool "STM32F446ME"
    config SOC_STM32F446RC
        bool "STM32F446RC"
    config SOC_STM32F446RE
        bool "STM32F446RE"
    config SOC_STM32F446VC
        bool "STM32F446VC"
    config SOC_STM32F446VE
        bool "STM32F446VE"
    config SOC_STM32F446ZC
        bool "STM32F446ZC"
    config SOC_STM32F446ZE
        bool "STM32F446ZE"
    config SOC_STM32F469AI
        bool "STM32F469AI"
    config SOC_STM32F469II
        bool "STM32F469II"
    config SOC_STM32F469BI
        bool "STM32F469BI"
    config SOC_STM32F469NI
        bool "STM32F469NI"
    config SOC_STM32F469AG
        bool "STM32F469AG"
    config SOC_STM32F469IG
        bool "STM32F469IG"
    config SOC_STM32F469BG
        bool "STM32F469BG"
    config SOC_STM32F469NG
        bool "STM32F469NG"
    config SOC_STM32F469AE
        bool "STM32F469AE"
    config SOC_STM32F469IE
        bool "STM32F469IE"
    config SOC_STM32F469BE
        bool "STM32F469BE"
    config SOC_STM32F469NE
        bool "STM32F469NE"
    config SOC_STM32F479AI
        bool "STM32F479AI"
    config SOC_STM32F479II
        bool "STM32F479II"
    config SOC_STM32F479BI
        bool "STM32F479BI"
    config SOC_STM32F479NI
        bool "STM32F479NI"
    config SOC_STM32F479AG
        bool "STM32F479AG"
    config SOC_STM32F479IG
        bool "STM32F479IG"
    config SOC_STM32F479BG
        bool "STM32F479BG"
    config SOC_STM32F479NG
        bool "STM32F479NG"
    config SOC_STM32F412CEU
        bool "STM32F412CEU"
    config SOC_STM32F412CGU
        bool "STM32F412CGU"
    config SOC_STM32F412ZET
        bool "STM32F412ZET"
    config SOC_STM32F412ZGT
        bool "STM32F412ZGT"
    config SOC_STM32F412ZEJ
        bool "STM32F412ZEJ"
    config SOC_STM32F412ZGJ
        bool "STM32F412ZGJ"
    config SOC_STM32F412VET
        bool "STM32F412VET"
    config SOC_STM32F412VGT
        bool "STM32F412VGT"
    config SOC_STM32F412VEH
        bool "STM32F412VEH"
    config SOC_STM32F412VGH
        bool "STM32F412VGH"
    config SOC_STM32F412RET
        bool "STM32F412RET"
    config SOC_STM32F412RGT
        bool "STM32F412RGT"
    config SOC_STM32F412REY
        bool "STM32F412REY"
    config SOC_STM32F412RGY
        bool "STM32F412RGY"
    config SOC_STM32F413CH
        bool "STM32F413CH"
    config SOC_STM32F413MH
        bool "STM32F413MH"
    config SOC_STM32F413RH
        bool "STM32F413RH"
    config SOC_STM32F413VH
        bool "STM32F413VH"
    config SOC_STM32F413ZH
        bool "STM32F413ZH"
    config SOC_STM32F413CG
        bool "STM32F413CG"
    config SOC_STM32F413MG
        bool "STM32F413MG"
    config SOC_STM32F413RG
        bool "STM32F413RG"
    config SOC_STM32F413VG
        bool "STM32F413VG"
    config SOC_STM32F413ZG
        bool "STM32F413ZG"
    config SOC_STM32F423CH
        bool "STM32F423CH"
    config SOC_STM32F423RH
        bool "STM32F423RH"
    config SOC_STM32F423VH
        bool "STM32F423VH"
    config SOC_STM32F423ZH
        bool "STM32F423ZH"
endchoice
menu "Onboard Peripheral Drivers"

    config BSP_USING_USB_TO_USART
        bool "Enable USB TO USART (uart1)"
        select BSP_USING_UART
        select BSP_USING_UART1
        default y

    config BSP_USING_COM2
        bool "Enable COM2 (uart2 pin conflict with Ethernet and PWM)"
        select BSP_USING_UART
        select BSP_USING_UART2
        default n

    config BSP_USING_COM3
        bool "Enable COM3 (uart3)"
        select BSP_USING_UART
        select BSP_USING_UART3
        default n
    
    config BSP_USING_SRAM
        bool "Enable SRAM"
        select BSP_USING_EXT_FMC_IO
        select BSP_USING_FMC
        default n

    config BSP_USING_SPI_FLASH
        bool "Enable SPI FLASH (W25Q128 spi1)"
        select BSP_USING_SPI
        select BSP_USING_SPI1
        select RT_USING_SFUD
        select RT_SFUD_USING_SFDP
        default n

    config BSP_USING_EEPROM
        bool "Enable I2C EEPROM (i2c1)"
        select BSP_USING_I2C1
        default n

    config PHY_USING_LAN8720A
        bool
    
    config BSP_USING_ETH
        bool "Enable Ethernet"
        default n
        select RT_USING_LWIP
        select PHY_USING_LAN8720A

    config BSP_USING_MPU6050
        bool "Enable MPU6050 (i2c1)"
        default n
        select BSP_USING_I2C1
        select PKG_USING_MPU6XXX

    config BSP_USING_SDCARD
        bool "Enable SDCARD (sdio)"
        select BSP_USING_SDIO
        select RT_USING_DFS
        select RT_USING_DFS_ELMFAT
        default n
    if BSP_USING_SDCARD
    config SDIO_MAX_FREQ
        int "sdio max freq"
        range 0 24000000
        default 1000000
    endif

endmenu

menu "On-chip Peripheral Drivers"

    config BSP_USING_GPIO
        bool "Enable GPIO"
        select RT_USING_PIN
        default y

    menuconfig BSP_USING_UART
        bool "Enable UART"
        default y
        select RT_USING_SERIAL
        if BSP_USING_UART
            config BSP_USING_UART1
                bool "Enable UART1"
                default y

            config BSP_UART1_RX_USING_DMA
                bool "Enable UART1 RX DMA"
                depends on BSP_USING_UART1 && RT_SERIAL_USING_DMA
                default n

            config BSP_UART1_TX_USING_DMA
                bool "Enable UART1 TX DMA"
                depends on BSP_USING_UART1 && RT_SERIAL_USING_DMA
                default n

            config BSP_USING_UART2
                bool "Enable UART2"
                default n

            config BSP_UART2_RX_USING_DMA
                bool "Enable UART2 RX DMA"
                depends on BSP_USING_UART2 && RT_SERIAL_USING_DMA
                default n

            config BSP_UART2_TX_USING_DMA
                bool "Enable UART2 TX DMA"
                depends on BSP_USING_UART2 && RT_SERIAL_USING_DMA
                default n

            config BSP_USING_UART3
                bool "Enable UART3"
                default n

            config BSP_UART3_RX_USING_DMA
                bool "Enable UART3 RX DMA"
                depends on BSP_USING_UART3 && RT_SERIAL_USING_DMA
                default n  

            config BSP_UART3_TX_USING_DMA
                bool "Enable UART3 TX DMA"
                depends on BSP_USING_UART3 && RT_SERIAL_USING_DMA
                default n

            config BSP_USING_UART4
                bool "Enable UART4"
                default n

            config BSP_UART4_RX_USING_DMA
                bool "Enable UART4 RX DMA"
                depends on BSP_USING_UART4 && RT_SERIAL_USING_DMA
                default n  

            config BSP_UART4_TX_USING_DMA
                bool "Enable UART4 TX DMA"
                depends on BSP_USING_UART4 && RT_SERIAL_USING_DMA
                default n

            config BSP_USING_UART5
                bool "Enable UART5"
                default n

            config BSP_UART5_RX_USING_DMA
                bool "Enable UART5 RX DMA"
                depends on BSP_USING_UART5 && RT_SERIAL_USING_DMA
                default n  

            config BSP_UART5_TX_USING_DMA
                bool "Enable UART5 TX DMA"
                depends on BSP_USING_UART5 && RT_SERIAL_USING_DMA
                default n

            config BSP_USING_UART6
                bool "Enable UART6"
                default n

            config BSP_UART6_RX_USING_DMA
                bool "Enable UART6 RX DMA"
                depends on BSP_USING_UART6 && RT_SERIAL_USING_DMA
                default n  

            config BSP_UART6_TX_USING_DMA
                bool "Enable UART6 TX DMA"
                depends on BSP_USING_UART6 && RT_SERIAL_USING_DMA
                default n
        endif
    config BSP_USING_ON_CHIP_FLASH
        bool "Enable on-chip FLASH"
        default n
    menuconfig BSP_USING_CAN
        bool "Enable CAN"
        default n
        select RT_USING_CAN
        if BSP_USING_CAN
            config BSP_USING_CAN1
                bool "Enable CAN1"
                default n
        endif

    menuconfig BSP_USING_SPI
        bool "Enable SPI BUS"
        default n
        select RT_USING_SPI
        if BSP_USING_SPI
            config BSP_USING_SPI1
                bool "Enable SPI1 BUS"
                default n

            config BSP_SPI1_TX_USING_DMA
                bool "Enable SPI1 TX DMA"
                depends on BSP_USING_SPI1
                default n
                
            config BSP_SPI1_RX_USING_DMA
                bool "Enable SPI1 RX DMA"
                depends on BSP_USING_SPI1
                select BSP_SPI1_TX_USING_DMA
                default n

            config BSP_USING_SPI2
                bool "Enable SPI2 BUS"
                default n  
                
            config BSP_SPI2_TX_USING_DMA
                bool "Enable SPI2 TX DMA"
                depends on BSP_USING_SPI2
                default n
                
            config BSP_SPI2_RX_USING_DMA
                bool "Enable SPI2 RX DMA"
                depends on BSP_USING_SPI2
                select BSP_SPI2_TX_USING_DMA
                default n
                
            config BSP_USING_SPI5
                bool "Enable SPI5 BUS"
                default n        

            config BSP_SPI5_TX_USING_DMA
                bool "Enable SPI5 TX DMA"
                depends on BSP_USING_SPI5
                default n
                
            config BSP_SPI5_RX_USING_DMA
                bool "Enable SPI5 RX DMA"
                depends on BSP_USING_SPI5
                select BSP_SPI5_TX_USING_DMA
                default n  
        endif

    menuconfig BSP_USING_I2C1
        bool "Enable I2C1 BUS (software simulation)"
        default n
        select RT_USING_I2C
        select RT_USING_I2C_BITOPS
        select RT_USING_PIN
        if BSP_USING_I2C1
            comment "Notice: PH4 --> 116; PH5 --> 117"
            config BSP_I2C1_SCL_PIN
                int "I2C1 scl pin number"
                range 1 176
                default 116
            config BSP_I2C1_SDA_PIN
                int "I2C1 sda pin number"
                range 1 176
                default 117
        endif

    menuconfig BSP_USING_TIM
        bool "Enable timer"
        default n
        select RT_USING_HWTIMER
        if BSP_USING_TIM
            config BSP_USING_TIM11
                bool "Enable TIM11"
                default n

            config BSP_USING_TIM13
                bool "Enable TIM13"
                default n

            config BSP_USING_TIM14
                bool "Enable TIM14"
                default n
        endif

    menuconfig BSP_USING_PWM
        bool "Enable pwm"
        default n
        select RT_USING_PWM
        if BSP_USING_PWM
        menuconfig BSP_USING_PWM2
            bool "Enable timer2 output pwm"
            default n
            if BSP_USING_PWM2
                config BSP_USING_PWM2_CH4
                    bool "Enable PWM2 channel4"
                    default n
            endif
        endif

    config BSP_USING_ON_CHIP_FLASH
        bool "Enable on-chip FLASH"
        default n

    menuconfig BSP_USING_SPI
        bool "Enable SPI BUS"
        default n
        select RT_USING_SPI
        if BSP_USING_SPI
            config BSP_USING_SPI1
                bool "Enable SPI1 BUS"
                default n

            config BSP_SPI1_TX_USING_DMA
                bool "Enable SPI1 TX DMA"
                depends on BSP_USING_SPI1
                default n
                
            config BSP_SPI1_RX_USING_DMA
                bool "Enable SPI1 RX DMA"
                depends on BSP_USING_SPI1
                select BSP_SPI1_TX_USING_DMA
                default n

            config BSP_USING_SPI2
                bool "Enable SPI2 BUS"
                default n

            config BSP_SPI2_TX_USING_DMA
                bool "Enable SPI2 TX DMA"
                depends on BSP_USING_SPI2
                default n
                
            config BSP_SPI2_RX_USING_DMA
                bool "Enable SPI2 RX DMA"
                depends on BSP_USING_SPI2
                select BSP_SPI2_TX_USING_DMA
                default n
        endif

    menuconfig BSP_USING_ADC
        bool "Enable ADC"
        default n
        select RT_USING_ADC
        if BSP_USING_ADC
            config BSP_USING_ADC1
                bool "Enable ADC1"
                default n
        endif

    menuconfig BSP_USING_I2C1
        bool "Enable I2C1 BUS (software simulation)"
        default y
        select RT_USING_I2C
        select RT_USING_I2C_BITOPS
        select RT_USING_PIN
        if BSP_USING_I2C1
            config BSP_I2C1_SCL_PIN
                int "i2c1 scl pin number"
                range 0 143
                default 24
            config BSP_I2C1_SDA_PIN
                int "I2C1 sda pin number"
                range 0 143
                default 25
        endif

    menuconfig BSP_USING_DAC
        bool "Enable DAC"
        default n
        select RT_USING_DAC
        if BSP_USING_DAC
            config BSP_USING_DAC1
                bool "Enable DAC1"
                default n
        endif

    menuconfig BSP_USING_ONCHIP_RTC
        bool "Enable RTC"
        select RT_USING_RTC
        select RT_USING_LIBC
        default n
        if BSP_USING_ONCHIP_RTC
            choice
                prompt "Select clock source"
                default BSP_RTC_USING_LSE

                config BSP_RTC_USING_LSE
                    bool "RTC USING LSE"

                config BSP_RTC_USING_LSI
                    bool "RTC USING LSI"
            endchoice
        endif

    config BSP_USING_WDT
        bool "Enable Watchdog Timer"
        select RT_USING_WDT
        default n

    config BSP_USING_SDIO
        bool "Enable SDIO"
        select RT_USING_SDIO
        select RT_USING_DFS
        default n

    config BSP_USING_USBD
        bool "Enable USB Device"
        select RT_USING_USB_DEVICE
        default n

    menuconfig BSP_USING_USBH
        bool "Enable USB Host"
        select RT_USING_USB_HOST
        default n
        if BSP_USING_USBH
            menuconfig RT_USBH_MSTORAGE
                bool "Enable Udisk Drivers"
                default n
                if RT_USBH_MSTORAGE
                    config UDISK_MOUNTPOINT
                    string "Udisk mount dir"
                    default "/"
                endif
        endif

    menuconfig BSP_USING_PULSE_ENCODER
        bool "Enable Pulse Encoder"
        default n
        select RT_USING_PULSE_ENCODER
        if BSP_USING_PULSE_ENCODER
            config BSP_USING_PULSE_ENCODER4
                bool "Enable Pulse Encoder4"
                default n

        endif
    
    config BSP_USING_EXT_FMC_IO
        bool
        default n

    config BSP_USING_FMC
        bool
        default n
 source "../libraries/HAL_Drivers/Kconfig"
    
endmenu

menu "Board extended module Drivers"
    config RT_USING_LCD
        bool "Enable LCD Device"
        default n
endmenu

endmenu
```
